#include "bastardkb.dtsi" // Notice that the main dtsi files are included in the overlay.

&default_transform { // The matrix transform for this board is 5
    col-offset = <5>;
};

&kscan0 {
    row-gpios //20(P0.29) 18(1.15) 14(P1.11) 10(P0.09)
        = <&pro_micro 20 (GPIO_ACTIVE_HIGH | GPIO_PULL_DOWN)> //  Row A from the schematic file
        , <&pro_micro 18 (GPIO_ACTIVE_HIGH | GPIO_PULL_DOWN)> //  Row B from the schematic file
        , <&pro_micro 14 (GPIO_ACTIVE_HIGH | GPIO_PULL_DOWN)> //  Row C from the schematic file
        , <&pro_micro 10 (GPIO_ACTIVE_HIGH | GPIO_PULL_DOWN)> //  Row D from the schematic file
        ;
    col-gpios //0(P0.08) 2(P0.17) 4(P0.22) 6(P1.00) 8(P1.04)
        = <&pro_micro 0 GPIO_ACTIVE_HIGH> // col1 in the schematic
        , <&pro_micro 2 GPIO_ACTIVE_HIGH> // col2 in the schematic
        , <&pro_micro 4 GPIO_ACTIVE_HIGH> // col3 in the schematic
        , <&pro_micro 6 GPIO_ACTIVE_HIGH> // col4 in the schematic
        , <&pro_micro 8 GPIO_ACTIVE_HIGH> // col5 in the schematic
        ;
};
